#include <DmxSimple.h>
//------------------------------------------------------------------------------------------------------------
//                                                  DMX_TEST
//------------------------------------------------------------------------------------------------------------
/*
 * Testeur de cannaux DMX, chaser linéaire avec rythme variable 
 * ->Exemple entree analogique
 * ->Exemple timer
 * ->Exemple sortie DMX
 */
 
#define DMX_NB_CHANNELS_TEST   12
int channelIndex;



//------------------------------------------------------------------------------------------------------------
//                                                  HARWARE
//------------------------------------------------------------------------------------------------------------
#define DMX_NB_CHANNELS     20
#define DMX_PIN_OUT         2
#define ANALOG_PIN_RYTHME   A0

//------------------------------------------------------------------------------------------------------------
//                                                  GLOBAL
//------------------------------------------------------------------------------------------------------------

//RYTHME
uint32_t rythmeTimer;


//------------------------------------------------------------------------------------------------------------
//                                                  TIMER
//------------------------------------------------------------------------------------------------------------
uint32_t Chrono(uint32_t *timer)
{
  uint32_t now = millis();
  uint32_t dif = now-*timer;
  return dif;
}


//------------------------------------------------------------------------------------------------------------
//                                                  DMX
//------------------------------------------------------------------------------------------------------------
void DMX_Clear()
{
  for (int i=0;i<DMX_NB_CHANNELS;i++)
    DmxSimple.write(i+1, 0);
}


//------------------------------------------------------------------------------------------------------------
//                                                  SETUP
//------------------------------------------------------------------------------------------------------------


void setup() 
{
  DmxSimple.usePin(DMX_PIN_OUT);
  DmxSimple.maxChannel(DMX_NB_CHANNELS);
}



//------------------------------------------------------------------------------------------------------------
//                                                  LOOP
//------------------------------------------------------------------------------------------------------------

void loop() 
{

  int rythmeDelay = map(analogRead(ANALOG_PIN_RYTHME),0,1023,1000,100);
  if (Chrono(&rythmeTimer)>rythmeDelay)
  {
    rythmeTimer=millis(); //Lis le chrono

    DMX_Clear();
    DmxSimple.write(channelIndex+1, 255);
    channelIndex++;
    if (channelIndex>DMX_NB_CHANNELS_TEST)
      channelIndex=0;
  }
}


